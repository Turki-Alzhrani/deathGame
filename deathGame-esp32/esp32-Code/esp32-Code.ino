#include <Wire.h>
#include <WiFi.h>
#include <WebSocketsServer.h>
#include <Adafruit_GFX.h>
#include <Adafruit_SSD1306.h>
#include <ArduinoJson.h> 

const int button = 34;
const int booster = 18;
unsigned long shockStartTime = 0;
bool shocking = false;

int guess = -1;
int myComputer = 0;
bool ready = false;

// my WiFi 
const char* ssid = "your wifi name";
const char* password = "your wifi password";
WebSocketsServer webSocket = WebSocketsServer(81);

void webSocketEvent(uint8_t num, WStype_t type, uint8_t * payload, size_t length) {
  if (type == WStype_TEXT) {
    String msg = (char*)payload;
    Serial.println("Received: " + msg);
    if (msg.startsWith("{")) {
      DynamicJsonDocument doc(64);
      deserializeJson(doc, msg);
      if (doc["type"] == "start") {
        guess = doc["number"];
        myComputer = random(1, 11);
        ready = true;
        shocking = false;
      }
    }
  }
}

#define SCREEN_WIDTH 128
#define SCREEN_HEIGHT 64
const unsigned char pic [] PROGMEM = {
	// 'RLfront, 64x48px
	0x00, 0x00, 0x00, 0x00, 0x00, 0x00, 0x00, 0x00, 0x00, 0x00, 0x00, 0x00, 0x00, 0x00, 0x00, 0x00, 
	0x00, 0x00, 0x00, 0x0f, 0xf0, 0x00, 0x00, 0x00, 0x00, 0x00, 0x00, 0x3f, 0xfc, 0x00, 0x00, 0x00, 
	0x00, 0x00, 0x00, 0xff, 0xff, 0x00, 0x00, 0x00, 0x00, 0x00, 0x01, 0xff, 0xff, 0x80, 0x00, 0x00, 
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	0x00, 0x00, 0x00, 0x0e, 0xe0, 0x00, 0x00, 0x00, 0x00, 0x00, 0x00, 0x00, 0x00, 0x00, 0x00, 0x00
};
#define OLED_RESET -1 
Adafruit_SSD1306 display(SCREEN_WIDTH, SCREEN_HEIGHT, &Wire, OLED_RESET);

void setup() {
  Serial.begin(115200);
  WiFi.begin(ssid, password);
  while (WiFi.status() != WL_CONNECTED) {
    delay(500); 
    Serial.print(".");
  }
  Serial.println("WiFi Connected!");
  Serial.println(WiFi.localIP());
  webSocket.begin();
  webSocket.onEvent(webSocketEvent);

  pinMode(button, INPUT);
  pinMode(booster, OUTPUT);
  digitalWrite(booster, LOW);

  Wire.begin(14, 13);
  display.begin(SSD1306_SWITCHCAPVCC, 0x3C);
  display.clearDisplay();
  display.display();



}

void loop() {
  webSocket.loop();

  if (ready && digitalRead(button) == HIGH && !shocking) {
    ready = false; 
    if (guess == myComputer) {
        display.clearDisplay();
      webSocket.broadcastTXT("result:win");
      display.setTextSize(2); 
      display.setTextColor(WHITE);
      display.setCursor(7, 0); 
      display.print("يخربيت حظك");
      display.display();
      delay(2000);
    } else {
      webSocket.broadcastTXT("result:lose");
      digitalWrite(booster, HIGH);
      shockStartTime = millis();
      shocking = true;
      display.clearDisplay();

      display.setTextSize(2); 
      display.setTextColor(WHITE);
      display.setCursor(7, 0); 
      display.print("Death Game");
      int x = (SCREEN_WIDTH - 64) / 2;
      int y = 16;
      display.drawBitmap(x, y, pic, 64, 48, WHITE);
      display.display();
    }
  } else if (!shocking && !ready) {
    display.clearDisplay();
    display.setTextSize(2); 
    display.setTextColor(WHITE);
    display.setCursor(7, 0); 
    display.print("Turki :)");
    display.display();
  }

  // إيقاف الصدمة بعد 5 ثواني
  if (shocking && millis() - shockStartTime >= 5000) {
    digitalWrite(booster, LOW);
    shocking = false;
    display.clearDisplay();
    display.display();
  }
}
